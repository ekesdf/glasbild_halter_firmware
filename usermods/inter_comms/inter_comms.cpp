#include "wled.h"
#include "inter_comms_internal.h"
#include "crypto.h"
#include <esp_app_desc.h>
#include <esp_mac.h>
#include <esp_random.h>

// AI: below section was generated by an AI
namespace InterCommsInternal {
using namespace InterCommsCrypto;

bool InterComms::provisioned() const { return INTER_COMMS_PROVISIONED; }

bool InterComms::settled() const { return _bootReady && elapsed(millis(), _started, SETTLE_MS); }

bool InterComms::master() const { return _leader < 0 && settled(); }

bool InterComms::ready() const { return provisioned() && _bootReady.load(); }

void InterComms::attachUi() { _uiAttached.store(true); }

void InterComms::executeAdmin(JsonObject request, JsonObject result) { admin(request, result); }

// Without the UI module, fail closed instead of exposing WLED's legacy HTTP routes.
bool InterComms::canHandle(AsyncWebServerRequest* request) { return !_uiAttached.load(); }

void InterComms::handleRequest(AsyncWebServerRequest* request) { request->send(503, "text/plain", "Install inter_comms_ui for dashboard access"); }

bool InterComms::hasExclusiveNetworkControl() const { return true; }

// Release buffered UDP packets before the Wi-Fi driver's receive-buffer owner is destroyed.
void InterComms::onNetworkReset() { _udp.stop(); _socketReady = false; _radio.stop(); }

// Give LAN association a normal startup window, then hold/search channels for the direct link.
uint8_t InterComms::getWiFiChannelRequest() const {
  if (!ready() || !_radio.ready() || WiFi.status() == WL_CONNECTED || forceReconnect) return 0;
  bool gateway = WiFi.softAPgetStationNum() > 0;
  for (const auto& peer : _peers) if (peer.live(millis()) && peer.canLead && peer.gatewayScore > 0) gateway = true;
  if (!InterCommsRadio::channelWindow(millis(), _lastLan ? _lastLan : _started, gateway)) return 0;
  return _radioChannel;
}

// Register before stock WLED handlers; this catch-all prevents plaintext control and file/OTA bypasses.
void InterComms::setup() {
  _radio.begin();
  strlcpy(_buildId, toHex(esp_app_get_description()->app_elf_sha256, BUILD_ID_BYTES).c_str(), sizeof(_buildId));
  _idValid = esp_read_mac(_id, ESP_MAC_WIFI_STA) == ESP_OK;
  mbedtls_sha256_init(&_firmware.sha); mbedtls_sha256_init(&_uploadSha);
  server.addHandler(this);
  receiveDirect = false; receiveGroups = 0; sendNotificationsRT = false;
#ifndef WLED_DISABLE_MQTT
  mqttEnabled = false;
#endif
#ifndef WLED_DISABLE_ALEXA
  alexaEnabled = false;
#endif
#ifndef WLED_DISABLE_HUESYNC
  huePollingEnabled = false;
#endif
#ifndef WLED_DISABLE_ESPNOW
  enableESPNow = false; useESPNowSync = false;
#endif
#ifdef WLED_ENABLE_AOTA
  aOtaEnabled = false;
#endif
}

// Create one boot epoch and send key after Wi-Fi exists; retry a failed initialization on the next loop.
bool InterComms::initializeSession() {
  if (!_bootReady) {
    if (WiFi.getMode() == WIFI_MODE_NULL) return false;
    esp_fill_random(_boot, 16);
    if (!deriveKey(_id, _boot, _sendKey)) return false;
    _bootReady = true;
    _started = millis();
    _commandId = esp_random();
  }
  return true;
}

// Keep transport, cryptography, settings, and OTA work serialized on the firmware main loop.
// Run admission and election before lighting synchronization, then service bounded update work.
void InterComms::loop() {
  if (!provisioned() || !_idValid || !initializeSession()) return;

  bool connected = WiFi.status() == WL_CONNECTED;
  serviceNetwork(connected);

  uint32_t now = millis();
  updateRadioChannel(now, connected);
  updateLeader(now);

  if ((_socketReady || _radio.ready()) && elapsed(millis(), _lastHello, HEARTBEAT_MS)) {
    heartbeat();
    _lastHello = millis();
  }
  if (_socketReady || _radio.ready()) synchronize();
  servicePreparation();
  serviceTransfers();
  serviceAutomaticUpdates();
}

void InterComms::onStateChange(uint8_t mode) { if (!_applying && mode != CALL_MODE_INIT) _changed.store(true); }

void InterComms::addToConfig(JsonObject& root) { root["inter_comms"]["sync"] = _sync; }

bool InterComms::readFromConfig(JsonObject& root) { _sync = root["inter_comms"]["sync"] | true; return true; }

void InterComms::addToJsonInfo(JsonObject& root) {
  JsonObject info = root["u"].is<JsonObject>() ? root["u"].as<JsonObject>() : root.createNestedObject("u");
  JsonArray value = info.createNestedArray("inter_comms"); value.add(provisioned() ? (master() ? "master" : "follower") : "not provisioned");
  JsonObject links = root.createNestedObject("interComms");
  links["radioReady"] = _radio.ready(); links["channel"] = WiFi.channel(); links["gatewayScore"] = _gatewayScore;
  links["masterId"] = toHex(_leader < 0 ? _id : _peers[_leader].id, sizeof(_id));
  links["invalidPackets"] = _invalidPackets; links["radioDropped"] = _radio.dropped();
  JsonArray peers = links.createNestedArray("peers");
  for (size_t i = 0; i < MAX_PEERS; i++) {
    if (!_peers[i].live(millis())) continue;
    JsonObject peer = peers.createNestedObject();
    peer["id"] = toHex(_peers[i].id, sizeof(_id)); peer["transport"] = _peers[i].address ? "udp" : "espnow";
    peer["radioRssi"] = _members[i].radioRssi; peer["wifiRssi"] = _members[i].wifiRssi;
    peer["gatewayScore"] = _peers[i].gatewayScore; peer["result"] = _members[i].result;
  }
}

} // namespace InterCommsInternal

static InterCommsInternal::InterComms interComms;
REGISTER_USERMOD(interComms);
InterCommsService& interCommsService() { return interComms; }
// AI: end
