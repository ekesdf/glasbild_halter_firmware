#include "wled.h"
#include "inter_comms_internal.h"
#include "crypto.h"
#include "wled_metadata.h"
#include <Update.h>
#include <esp_ota_ops.h>
#include <esp_image_format.h>
#include <esp_app_desc.h>

// AI: below section was generated by an AI
namespace InterCommsInternal {
using namespace InterCommsCrypto;

static const char STAGED_IMAGE[] = "/inter_comms.bin";
static const char UPLOAD_IMAGE[] = "/inter_comms.part";

// A source image is either a verified LittleFS upload or the running application partition.
// Staging never activates an OTA slot: beginFirmware reserves a transfer, writeFirmware checks
// its first chunk before writing, and Update.end runs only after the full hash/profile checks.

// A build fingerprint distinguishes rebuilt images that share the same WLED version string.
void InterComms::imageBuildId(const uint8_t* data, size_t length, char* output) {
  constexpr size_t APP_DESCRIPTION_OFFSET = sizeof(esp_image_header_t) + sizeof(esp_image_segment_header_t);
  constexpr size_t HASH_OFFSET = APP_DESCRIPTION_OFFSET + offsetof(esp_app_desc_t, app_elf_sha256);
  output[0] = 0;
  if (length < HASH_OFFSET + BUILD_ID_BYTES) return;
  uint32_t magic;
  memcpy(&magic, data + APP_DESCRIPTION_OFFSET, sizeof(magic));
  if (magic == ESP_APP_DESC_MAGIC_WORD) strlcpy(output, toHex(data + HASH_OFFSET, BUILD_ID_BYTES).c_str(), BUILD_ID_LENGTH);
}

// Read only the chosen application image; the running-image source needs no filesystem staging copy.
bool InterComms::readImage(uint32_t offset, uint8_t* buffer, size_t length) {
  if (offset > _stagedSize || length > _stagedSize - offset) return false;
  if (_sourceRunning) return _runningPartition && esp_partition_read(_runningPartition, offset, buffer, length) == ESP_OK;
  File image = WLED_FS.open(STAGED_IMAGE, "r");
  return image && image.seek(offset) && image.read(buffer, length) == length;
}

// An offered image stays in use until every tracked recipient completes or fails.
bool InterComms::remoteUpdatesActive() const {
  for (const auto& member : _members) if (member.updateTracked && member.updatePhase != Complete && member.updatePhase != Failed) return true;
  return false;
}

// ESP-IDF supplies the application's exact length, including its appended image hash, not the partition capacity.
bool InterComms::prepareCurrent() {
  _commandError[0] = 0;
  if (_preparingCurrent || _upload || _firmware.active || remoteUpdatesActive()) {
    strlcpy(_commandError, "Finish the active upload or update before preparing another image", sizeof(_commandError)); return false;
  }
  _runningPartition = esp_ota_get_running_partition();
  esp_image_metadata_t metadata = {};
  if (!_runningPartition) { strlcpy(_commandError, "Running application partition is unavailable", sizeof(_commandError)); return false; }
  esp_partition_pos_t position = {_runningPartition->address, _runningPartition->size};
  if (esp_image_get_metadata(&position, &metadata) != ESP_OK || metadata.image_len < FIRMWARE_CHUNK || metadata.image_len > _runningPartition->size) {
    strlcpy(_commandError, "Could not read the running application image metadata", sizeof(_commandError)); return false;
  }
  if (mbedtls_sha256_starts(&_uploadSha, 0)) { strlcpy(_commandError, "SHA-256 initialization failed", sizeof(_commandError)); return false; }
  _prepareSize = metadata.image_len; _prepareOffset = 0; _preparingCurrent = true;
  _staged = false; _updatePhase = Preparing;
  strlcpy(_updateStatus, "Preparing this device's running firmware", sizeof(_updateStatus));
  return true;
}

// Hash a bounded portion per loop so the dashboard can report preparation progress.
void InterComms::servicePreparation() {
  if (!_preparingCurrent) return;
  size_t count = std::min(size_t(1024), size_t(_prepareSize - _prepareOffset));
  if (esp_partition_read(_runningPartition, _prepareOffset, _plain, count) != ESP_OK || mbedtls_sha256_update(&_uploadSha, _plain, count)) {
    _preparingCurrent = false; _updatePhase = Failed;
    strlcpy(_updateStatus, "Reading the running application failed", sizeof(_updateStatus)); return;
  }
  _prepareOffset += count;
  if (_prepareOffset != _prepareSize) return;
  if (mbedtls_sha256_finish(&_uploadSha, _stagedHash)) {
    _preparingCurrent = false; _updatePhase = Failed; strlcpy(_updateStatus, "Firmware SHA-256 failed", sizeof(_updateStatus)); return;
  }
  _stagedSize = _prepareSize; _sourceRunning = true; _staged = true; _preparingCurrent = false;
  strlcpy(_stagedBuild, _buildId, sizeof(_stagedBuild));
  _updatePhase = Idle; strlcpy(_updateStatus, "Running firmware ready to send", sizeof(_updateStatus));
}

// Fixed-target compatibility is checked before staging or writing OTA flash; report the actual rejection.
bool InterComms::compatible(const uint8_t* data, size_t length, char* error, size_t errorLength) {
  wled_metadata_t metadata;
  if (length < FIRMWARE_CHUNK || data[0] != 0xe9) {
    strlcpy(error, "Select a complete application firmware.bin, not a merged flash image", errorLength);
    return false;
  }
  if (!findWledMetadata(data, length, &metadata)) {
    strlcpy(error, "Application image is missing valid WLED compatibility metadata", errorLength);
    return false;
  }
  return shouldAllowOTA(metadata, error, errorLength);
}

// Release OTA's strip suspension when needed and retain a failure message for the dashboard.
void InterComms::abortFirmware(const char* reason) {
  if (_firmware.started) { Update.abort(); strip.resume(); UsermodManager::onUpdateBegin(false); }
  _firmware.active = _firmware.started = false;
  _updatePhase = Failed;
  strlcpy(_updateStatus, reason, sizeof(_updateStatus));
}

// Preserve the platform OTA error before aborting clears the updater state.
void InterComms::abortOta(const char* operation) {
  char error[160];
  snprintf(error, sizeof(error), "%s: %s", operation, Update.errorString());
  abortFirmware(error);
}

// Accept only sequential authenticated chunks; verify the full SHA-256 before activating an OTA slot.
bool InterComms::writeFirmware(const uint8_t* data, size_t length) {
  if (!_firmware.active || !length || length > _firmware.size - _firmware.offset) return false;
  if (!_firmware.started) {
    char error[160] = {};
    if (!compatible(data, length, error, sizeof(error))) { abortFirmware(error); return false; }
    if (Update.isRunning()) { abortFirmware("Another OTA update is already running"); return false; }
    UsermodManager::onUpdateBegin(true);
    strip.suspend();
    if (!Update.begin(_firmware.size)) { strip.resume(); UsermodManager::onUpdateBegin(false); abortOta("OTA allocation failed"); return false; }
    _firmware.started = true;
    if (mbedtls_sha256_starts(&_firmware.sha, 0)) { abortFirmware("SHA-256 initialization failed"); return false; }
  }
  _firmwareProfile.feed(data, length, INTER_COMMS_IMAGE_ID);
  if (Update.write(const_cast<uint8_t*>(data), length) != length) { abortOta("OTA write failed"); return false; }
  if (mbedtls_sha256_update(&_firmware.sha, data, length)) { abortFirmware("Firmware SHA-256 update failed"); return false; }
  _firmware.offset += length; _firmware.lastProgress = millis();
  _firmware.lastRequest = millis() - 250;
  if (_firmware.offset == _firmware.size) {
    _updatePhase = Verifying;
    uint8_t digest[32];
    if (mbedtls_sha256_finish(&_firmware.sha, digest) || !equal(digest, _firmware.hash, 32) || !_firmwareProfile.found) { abortFirmware("Firmware hash or group profile mismatch"); return false; }
    if (!Update.end(false)) { abortOta("OTA image validation failed"); return false; }
    _firmware.active = _firmware.started = false;
    _updatePhase = Rebooting;
    strlcpy(_updateStatus, "Verified; rebooting", sizeof(_updateStatus));
    if (_firmware.source >= 0) sendHeartbeat(_firmware.source);
    doReboot = true;
  }
  return true;
}

// OTA offers bind an authenticated group source to a fixed size and digest; active distribution must finish before rebooting.
bool InterComms::beginFirmware(JsonObject body, int source) {
  const esp_partition_t* partition = esp_ota_get_next_update_partition(nullptr);
  uint32_t size = body["size"] | 0U;
  uint8_t hash[32];
  _commandError[0] = 0;
  if (_firmware.active || _upload || _preparingCurrent || remoteUpdatesActive() || Update.isRunning()) { strlcpy(_commandError, "Device is busy with another upload or update", sizeof(_commandError)); return false; }
  if (!partition || size < FIRMWARE_CHUNK || size > partition->size || !fromHex(body["sha256"], hash, 32)) { strlcpy(_commandError, "Invalid firmware manifest or OTA partition size", sizeof(_commandError)); return false; }
  _firmwareProfile = ProfileMatcher();
  _firmware.active = true; _firmware.started = false; _firmware.local = source < 0;
  _firmware.source = source;
  if (source >= 0) memcpy(_firmware.sourceBoot, _peers[source].boot, sizeof(_firmware.sourceBoot));
  _firmware.size = size; _firmware.offset = 0;
  _firmware.lastProgress = millis(); _firmware.lastRequest = millis() - 500;
  memcpy(_firmware.hash, hash, 32);
  _updatePhase = Downloading;
  strlcpy(_updateStatus, "Downloading firmware", sizeof(_updateStatus));
  return true;
}

// Keep staging errors specific and discard incomplete files when a failed upload is abandoned.
bool InterComms::uploadFailed(const char* reason, bool discard) {
  strlcpy(_uploadError, reason, sizeof(_uploadError));
  _updatePhase = Failed;
  strlcpy(_updateStatus, reason, sizeof(_updateStatus));
  if (discard) { _upload.close(); WLED_FS.remove(UPLOAD_IMAGE); }
  return false;
}

// Stage a selected image with sequential chunks and full-image integrity checks.
bool InterComms::stage(const char* op, JsonObject body) {
  _uploadError[0] = 0;
  if (!strcmp(op, "uploadAbort")) {
    _upload.close(); WLED_FS.remove(UPLOAD_IMAGE);
    _uploadOffset = _uploadSize = 0;
    if (_updatePhase != Failed) {
      _updatePhase = Idle;
      strlcpy(_updateStatus, _staged ? "Firmware staged and verified" : "Upload cancelled", sizeof(_updateStatus));
    }
    return true;
  }
  if (!strcmp(op, "uploadBegin")) {
    const esp_partition_t* partition = esp_ota_get_next_update_partition(nullptr);
    uint32_t size = body["size"] | 0U;
    uint8_t hash[32];
    if (_preparingCurrent || remoteUpdatesActive()) return uploadFailed("Finish the active preparation or follower update first");
    if (_firmware.active || Update.isRunning()) return uploadFailed("An OTA update is already running");
    if (_upload) return uploadFailed("An upload is already active; cancel it before starting again");
    if (!partition) return uploadFailed("No OTA application partition is available");
    if (size < FIRMWARE_CHUNK || size > partition->size) return uploadFailed("Application image does not fit the OTA partition");
    if (!fromHex(body["sha256"], hash, sizeof(hash))) return uploadFailed("Invalid firmware SHA-256");
    _uploadProfile = ProfileMatcher();
    _staged = false; _sourceRunning = false; _stagedBuild[0] = 0; _updatePhase = Idle;
    WLED_FS.remove(STAGED_IMAGE); WLED_FS.remove(UPLOAD_IMAGE);
    if (WLED_FS.totalBytes() - WLED_FS.usedBytes() < size + 65536) return uploadFailed("Not enough filesystem space to stage this firmware");
    _upload = WLED_FS.open(UPLOAD_IMAGE, "w");
    if (!_upload) return uploadFailed("Could not create the temporary firmware file");
    if (mbedtls_sha256_starts(&_uploadSha, 0)) return uploadFailed("SHA-256 initialization failed", true);
    memcpy(_uploadHash, hash, sizeof(hash)); _uploadSize = size; _uploadOffset = 0; _uploadActivity = millis();
    strlcpy(_updateStatus, "Uploading firmware", sizeof(_updateStatus));
    return true;
  }
  if (!strcmp(op, "uploadChunk")) {
    const char* encoded = body["data"];
    size_t chars = encoded ? strnlen(encoded, FIRMWARE_CHUNK * 2 + 1) : 0;
    uint32_t offset = body["offset"] | UINT32_MAX;
    uint8_t bytes[FIRMWARE_CHUNK];
    if (!_upload) return uploadFailed("No upload is active; start staging again");
    if (!chars || chars % 2 || chars > FIRMWARE_CHUNK * 2 || !fromHex(encoded, bytes, chars / 2)) return uploadFailed("Invalid firmware chunk");
    if (offset != _uploadOffset || chars / 2 > _uploadSize - _uploadOffset) return uploadFailed("Firmware chunk offset or size does not match the upload");
    if (!offset) {
      char error[160] = {};
      if (!compatible(bytes, chars / 2, error, sizeof(error))) return uploadFailed(error, true);
      imageBuildId(bytes, chars / 2, _stagedBuild);
    }
    if (_upload.write(bytes, chars / 2) != chars / 2) return uploadFailed("Writing the firmware staging file failed", true);
    if (mbedtls_sha256_update(&_uploadSha, bytes, chars / 2)) return uploadFailed("Firmware SHA-256 update failed", true);
    _uploadProfile.feed(bytes, chars / 2, INTER_COMMS_IMAGE_ID);
    _uploadOffset += chars / 2; _uploadActivity = millis();
    return true;
  }
  if (!strcmp(op, "uploadFinish")) {
    if (!_upload || _uploadOffset != _uploadSize) return uploadFailed("Firmware upload is incomplete");
    _upload.close();
    uint8_t digest[32];
    if (mbedtls_sha256_finish(&_uploadSha, digest) || !equal(digest, _uploadHash, sizeof(digest))) return uploadFailed("Firmware SHA-256 mismatch", true);
    if (!_uploadProfile.found) return uploadFailed("Firmware was built for different group keys or lacks inter_comms", true);
    if (!WLED_FS.rename(UPLOAD_IMAGE, STAGED_IMAGE)) return uploadFailed("Could not finalize the firmware staging file", true);
    _staged = true; _stagedSize = _uploadSize; memcpy(_stagedHash, digest, sizeof(digest));
    strlcpy(_updateStatus, "Firmware staged and verified", sizeof(_updateStatus));
    return true;
  }
  return uploadFailed("Unknown firmware upload operation");
}

// Install the verified source locally, or queue follower offers and report queued/skipped/failed totals.
void InterComms::distributeFirmware(const char* op, const char* target, JsonObject result) {
  if (!_staged) { result["error"] = "Stage a verified firmware image first"; return; }
  DynamicJsonDocument manifest(256);
  manifest["size"] = _stagedSize; manifest["sha256"] = toHex(_stagedHash, 32); manifest["buildId"] = _stagedBuild;
  if (!strcmp(op, "installLocal")) {
    if (remoteUpdatesActive()) { result["error"] = "Wait for follower updates to finish before updating this master"; return; }
    result["ok"] = beginFirmware(manifest.as<JsonObject>(), -1); if (_commandError[0]) result["error"] = _commandError; return;
  }
  bool all = !strcmp(target, "all");
  uint8_t targetId[6];
  if (!all && !fromHex(target, targetId, sizeof(targetId))) { result["error"] = "Invalid firmware target"; return; }
  unsigned queued = 0, skipped = 0, failed = 0;
  for (size_t i = 0; i < MAX_PEERS; i++) {
    Member& member = _members[i];
    if (!_peers[i].live(millis()) || (!all && !equal(targetId, _peers[i].id, sizeof(targetId)))) continue;
    if (_stagedBuild[0] && !strcmp(member.buildId, _stagedBuild)) { skipped++; continue; }
    if (member.updateTracked && member.updatePhase != Failed && member.updatePhase != Complete) { failed++; continue; }
    if (!queueCommand(i, "firmware", manifest.as<JsonObject>())) { failed++; continue; }
    member.updateTracked = true; member.rebootDetected = false; member.updatePhase = QueuedUpdate;
    member.updateOffset = 0; member.updateSize = _stagedSize; member.updateProgressAt = millis();
    strlcpy(member.expectedBuild, _stagedBuild, sizeof(member.expectedBuild)); queued++;
  }
  result["ok"] = queued > 0; result["queued"] = queued; result["skipped"] = skipped; result["failed"] = failed;
  if (!queued) result["error"] = skipped ? "Selected followers already have this firmware build" : failed ? "Selected followers are busy" : "No authenticated follower is available";
  return;
}

// Retry control commands and firmware chunk requests without blocking the render loop.
void InterComms::serviceTransfers() {
  uint32_t now = millis();
  serviceCommands(now);
  for (auto& member : _members) if (member.updateTracked && member.updatePhase != Complete && member.updatePhase != Failed && elapsed(now, member.updateProgressAt, UPDATE_TIMEOUT_MS)) {
    member.updatePhase = Failed; strlcpy(member.result, "No update progress or verified reboot within 30 seconds", sizeof(member.result));
  }
  if (_upload && elapsed(now, _uploadActivity, UPDATE_TIMEOUT_MS)) { _upload.close(); WLED_FS.remove(UPLOAD_IMAGE); }
  if (!_firmware.active) return;
  if (elapsed(now, _firmware.lastProgress, UPDATE_TIMEOUT_MS)) { abortFirmware("Update timed out; previous image retained"); return; }
  if (_firmware.local) {
    uint8_t bytes[FIRMWARE_CHUNK];
    size_t length = std::min(size_t(FIRMWARE_CHUNK), size_t(_firmware.size - _firmware.offset));
    if (!readImage(_firmware.offset, bytes, length)) { abortFirmware("Firmware source read failed"); return; }
    writeFirmware(bytes, length);
  } else {
    if (!_peers[_firmware.source].live(now) || !equal(_firmware.sourceBoot, _peers[_firmware.source].boot, sizeof(_firmware.sourceBoot))) { abortFirmware("Firmware source disconnected or restarted; retry transfer"); return; }
    if (elapsed(now, _firmware.lastRequest, 250)) {
      uint8_t request[36]; write32(request, _firmware.offset); memcpy(request + 4, _firmware.hash, 32);
      sendPeer(_firmware.source, FirmwareRequest, request, sizeof(request)); _firmware.lastRequest = now;
    }
  }
}

// The newest stable release distributes its own running image, with MAC tie-breaking independent of lighting election.
void InterComms::serviceAutomaticUpdates() {
  uint32_t now = millis();
  if ((!_socketReady && !_radio.ready()) || !elapsed(now, _started, AUTO_UPDATE_SETTLE_MS) || !elapsed(now, _autoCheckAt, AUTO_UPDATE_CHECK_MS)) return;
  _autoCheckAt = now;
  ReleaseVersion current;
  if (!current.parse(versionString)) { strlcpy(_autoStatus, "Automatic updates require a stable major.minor.patch release", sizeof(_autoStatus)); return; }
  for (size_t i = 0; i < MAX_PEERS; i++) {
    if (!_peers[i].live(now) || (_members[i].simulated && !_members[i].autoUpdates)) continue;
    ReleaseVersion remote;
    if (!remote.parse(_members[i].firmwareVersion)) continue;
    int order = remote.compare(current);
    if (order > 0 || (order == 0 && memcmp(_peers[i].id, _id, sizeof(_id)) < 0)) {
      strlcpy(_autoStatus, "Waiting for the newest device to distribute firmware", sizeof(_autoStatus)); return;
    }
  }
  if (_upload || _preparingCurrent || _firmware.active || remoteUpdatesActive()) return;
  int target = -1;
  for (size_t i = 0; i < MAX_PEERS; i++) {
    Member& member = _members[i];
    if (!_peers[i].live(now)) continue;
    if (member.updatePhase >= Downloading && member.updatePhase <= Rebooting) return;
    if ((member.simulated && !member.autoUpdates) || !member.peerUpdates || member.commandLength || !elapsed(now, _peers[i].admittedAt, SETTLE_MS + HEARTBEAT_MS)) continue;
    ReleaseVersion remote;
    if (!remote.parse(member.firmwareVersion) || current.compare(remote) <= 0) continue;
    if (member.autoAttempts >= AUTO_UPDATE_ATTEMPTS || (member.autoAttempts && !elapsed(now, member.autoAttemptAt, AUTO_UPDATE_RETRY_MS))) continue;
    if (target < 0 || memcmp(_peers[i].id, _peers[target].id, sizeof(_id)) < 0) target = i;
  }
  if (target < 0) { strlcpy(_autoStatus, "No eligible older devices; failed attempts retry after five minutes (maximum three)", sizeof(_autoStatus)); return; }
  if (_staged && !_sourceRunning) { strlcpy(_autoStatus, "Automatic distribution paused while a manually uploaded image is staged", sizeof(_autoStatus)); return; }
  if (!_staged || strcmp(_stagedBuild, _buildId)) {
    if (_autoPrepareTried && !elapsed(now, _autoPrepareAt, AUTO_UPDATE_RETRY_MS)) return;
    _autoPrepareAt = now; _autoPrepareTried = true;
    if (!prepareCurrent()) strlcpy(_autoStatus, _commandError, sizeof(_autoStatus));
    else strlcpy(_autoStatus, "Preparing running firmware for automatic distribution", sizeof(_autoStatus));
    return;
  }
  DynamicJsonDocument manifest(384);
  manifest["size"] = _stagedSize; manifest["sha256"] = toHex(_stagedHash, 32); manifest["buildId"] = _stagedBuild;
  manifest["automatic"] = true; manifest["version"] = versionString;
  if (!queueCommand(target, "firmware", manifest.as<JsonObject>())) return;
  Member& member = _members[target];
  member.autoAttempts++; member.autoAttemptAt = now;
  member.updateTracked = true; member.rebootDetected = false; member.updatePhase = QueuedUpdate;
  member.updateOffset = 0; member.updateSize = _stagedSize; member.updateProgressAt = now;
  strlcpy(member.expectedBuild, _stagedBuild, sizeof(member.expectedBuild));
  strlcpy(_autoStatus, "Automatically updating an older device; waiting for verified reboot", sizeof(_autoStatus));
}

} // namespace InterCommsInternal
// AI: end
