#include "wled.h"
#include "inter_comms_internal.h"
#include "crypto.h"
#include <esp_random.h>

// AI: below section was generated by an AI
namespace InterCommsInternal {
using namespace InterCommsCrypto;

constexpr unsigned RADIO_RECEIVE_BUDGET = 8;
constexpr unsigned UDP_RECEIVE_BUDGET = 3;

// Drain fixed receive budgets so bursts cannot monopolize WLED's main loop or delay effects.
void InterComms::serviceNetwork(bool connected) {
  if (connected && !_socketReady) _socketReady = _udp.begin(PORT) == 1;
  if (!connected && _socketReady) { _udp.stop(); _socketReady = false; }
  _radio.service();
  for (unsigned i = 0; i < RADIO_RECEIVE_BUDGET; i++) {
    size_t length = 0; int8_t rssi = 0; uint8_t channel = 0;
    if (_radio.receive(_receive, length, rssi, channel)) processPacket(length, 0, true, rssi, channel);
  }
  if (_socketReady) for (unsigned i = 0; i < UDP_RECEIVE_BUDGET; i++) receivePacket();
}

// Prefer the LAN/AP channel, retain an authenticated direct link, and search only after the join window.
void InterComms::updateRadioChannel(uint32_t now, bool connected) {
  bool directPeer = false;
  for (const auto& peer : _peers) if (peer.live(now) && peer.address == 0) directPeer = true;
  if (connected || WiFi.softAPgetStationNum() > 0) {
    uint8_t channel = WiFi.channel();
    if (channel >= 1 && channel <= 13) _radioChannel = channel;
    _radioSearchAt = now;
    if (connected) _lastLan = now;
  } else if (directPeer) {
    // Retain the authenticated peer's receive channel, rather than a background scan's current channel.
    _radioSearchAt = now;
  } else if (!elapsed(now, _lastLan ? _lastLan : _started, WIFI_JOIN_MS)) {
    _radioSearchAt = now;
  } else if (elapsed(now, _radioSearchAt, _radioDwell)) {
    wifi_country_t country = {};
    uint8_t first = 1, last = 11;
    if (esp_wifi_get_country(&country) == ESP_OK && country.nchan > 0 && country.schan >= 1 && country.schan <= 13) {
      first = country.schan; last = std::min(unsigned(13), unsigned(country.schan + country.nchan - 1));
    }
    _radioChannel = _radioChannel < first || _radioChannel >= last ? first : _radioChannel + 1;
    _radioSearchAt = now;
    _radioDwell = RADIO_SEARCH_MS + esp_random() % 2001;
  }
}

// Require a better candidate to remain preferred before replacing a live gateway; failed gateways yield immediately.
void InterComms::updateLeader(uint32_t now) {
  int leader = elect(_id, _peers, MAX_PEERS, now, true, _gatewayScore);
  bool incumbentLive = _leader < 0 ? gatewayScore() > 0 : _peers[_leader].live(now) && _peers[_leader].canLead && _peers[_leader].gatewayScore > 0;
  if (leader != _leader && incumbentLive) {
    if (_leaderCandidate != leader) { _leaderCandidate = leader; _candidateSince = now; }
    if (!elapsed(now, _candidateSince, LEADER_STABLE_MS)) leader = _leader;
  } else _leaderCandidate = -2;
  if (leader != _leader) {
    _leader = leader;
    // A new leader publishes its state; followers wait for that state before proposing edits.
    _dirty = _leader < 0;
    for (auto& member : _members) if (member.commandLength && !member.updateTracked) { member.commandLength = 0; strlcpy(member.result, "Master changed", sizeof(member.result)); }
  }
}

// A LAN-connected gateway outranks a fallback AP; 5 dB bands reduce election noise.
uint8_t InterComms::gatewayScore() const {
  if (WiFi.status() == WL_CONNECTED) return 2 + constrain((WiFi.RSSI() + 100) / 5, 0, 16);
  return WiFi.softAPgetStationNum() > 0 ? 1 : 0;
}

// Allocate only free/expired peer entries; unauthenticated discovery cannot evict live members.
int InterComms::peerFor(const uint8_t* id, bool create) {
  int available = -1;
  uint32_t now = millis();
  for (size_t i = 0; i < MAX_PEERS; i++) {
    if (_peers[i].occupied && equal(_peers[i].id, id, 6)) return i;
    if (!_peers[i].live(now) && (!_peers[i].pending || elapsed(now, _peers[i].challenged, CHALLENGE_MS))) available = i;
  }
  if (!create || available < 0) return -1;
  _peers[available] = Peer();
  _members[available] = Member();
  memcpy(_peers[available].id, id, 6);
  _peers[available].occupied = true;
  return available;
}

// Build an authenticated datagram; receiver epochs bind unicast packets to the current boot.
bool InterComms::sendPacket(Kind kind, const uint8_t* payload, size_t length, IPAddress address, const uint8_t* recipient, bool radio, const uint8_t* radioRecipient) {
  if ((!radio && !_socketReady) || length > MAX_PAYLOAD || _sequence == UINT32_MAX) return false;
  memcpy(_send, "ICM1", 4); _send[4] = 1; _send[5] = kind;
  memcpy(_send + 6, _id, 6); memcpy(_send + 12, _boot, 16);
  if (recipient) memcpy(_send + 28, recipient, 16); else memset(_send + 28, 0, 16);
  write32(_send + 44, ++_sequence);
  _send[48] = length >> 8; _send[49] = length;
  uint8_t nonce[12] = {};
  write32(nonce + 8, _sequence);
  if (!crypt(true, _sendKey, nonce, _send, HEADER_SIZE, payload, length, _send + HEADER_SIZE, _send + HEADER_SIZE + length)) return false;
  if (radio) return _radio.send(_send, HEADER_SIZE + length + TAG_SIZE, radioRecipient);
  if (!_udp.beginPacket(address, PORT)) return false;
  _udp.write(_send, HEADER_SIZE + length + TAG_SIZE);
  return _udp.endPacket() == 1;
}

bool InterComms::sendPeer(int peer, Kind kind, const uint8_t* data, size_t length) {
  return peer >= 0 && _peers[peer].live(millis()) && sendPacket(kind, data, length, IPAddress(_peers[peer].address), _peers[peer].boot, _peers[peer].address == 0, _peers[peer].id);
}

// Serialize bounded documents once before transmission.
bool InterComms::sendJson(int peer, Kind kind, JsonDocument& document) {
  if (document.overflowed() || measureJson(document) > MAX_PAYLOAD) return false;
  size_t size = serializeJson(document, _plain, MAX_PAYLOAD);
  return sendPeer(peer, kind, _plain, size);
}

// UDP and ESP-NOW feed the same authentication and admission state machine.
void InterComms::receivePacket() {
  int size = _udp.parsePacket();
  if (size <= 0) return;
  if (size > int(MAX_FRAME)) { while (_udp.available()) _udp.read(); _invalidPackets++; return; }
  int received = _udp.read(_receive, sizeof(_receive));
  if (received != size) { _invalidPackets++; return; }
  processPacket(size, uint32_t(_udp.remoteIP()), false, 0);
}

// Zero is the ESP-NOW endpoint; its sender MAC was bound to the frame during reassembly.
// Admission order is frame/receiver validation, GCM authentication, challenge proof, then replay/lease checks.
void InterComms::processPacket(size_t size, uint32_t address, bool radio, int8_t rssi, uint8_t channel) {
  if (!validFrame(_receive, size) || equal(_receive + 6, _id, 6)) { _invalidPackets++; return; }
  Kind kind = Kind(_receive[5]);
  if (kind != Hello && !equal(_receive + 28, _boot, 16)) return;
  uint8_t key[32], nonce[12] = {};
  uint32_t sequence = read32(_receive + 44);
  write32(nonce + 8, sequence);
  size_t length = size - HEADER_SIZE - TAG_SIZE;
  if (!deriveKey(_receive + 6, _receive + 12, key) || !crypt(false, key, nonce, _receive, HEADER_SIZE, _receive + HEADER_SIZE, length, _plain, _receive + HEADER_SIZE + length)) { _invalidPackets++; return; }
  if (radio && channel >= 1 && channel <= 13) _radioChannel = channel;
  if (kind == Hello) {
    int index = peerFor(_receive + 6, true);
    if (index < 0) return;
    Peer& peer = _peers[index];
    if (peer.live(millis()) && equal(peer.boot, _receive + 12, 16) && (!radio || peer.address == 0)) {
      if (length == 1 && address == peer.address && sequence > peer.sequence) { peer.canLead = _plain[0] != 0; peer.sequence = sequence; }
      return;
    }
    if (peer.pending && !elapsed(millis(), peer.challenged, CHALLENGE_MS) && (!radio || peer.pendingAddress == 0)) return;
    peer.pendingCanLead = length != 1 || _plain[0] != 0;
    memcpy(peer.pendingBoot, _receive + 12, 16); peer.pendingAddress = address;
    esp_fill_random(peer.challenge, 16); peer.pending = true; peer.challenged = millis();
    sendPacket(Probe, peer.challenge, 16, IPAddress(address), peer.pendingBoot, radio, _receive + 6);
    return;
  }
  if (kind == Probe) { if (length == 16) sendPacket(Proof, _plain, length, IPAddress(address), _receive + 12, radio, _receive + 6); return; }
  int index = peerFor(_receive + 6, false);
  if (index < 0) return;
  Peer& peer = _peers[index];
  if (kind == Proof) {
    bool identified = peer.verified;
    bool newBoot = peer.verified && !equal(peer.boot, _receive + 12, sizeof(peer.boot));
    if (length == 16 && peer.prove(_receive + 12, _plain, address, sequence, millis())) {
      if (_members[index].updateTracked) {
        _members[index].commandLength = 0;
        if (newBoot) { _members[index].rebootDetected = true; _members[index].updatePhase = Rebooting; _members[index].updateProgressAt = millis(); }
      } else if (!identified || newBoot) _members[index] = Member();
      _dirty = _leader < 0;
    }
    return;
  }
  if (!peer.accept(_receive + 12, address, sequence, millis())) return;
  if (radio) _members[index].radioRssi = rssi;
  processAuthenticatedPacket(index, kind, length, address);
}

// The caller has verified GCM, the receiver boot epoch, peer admission and replay protection.
void InterComms::processAuthenticatedPacket(int index, Kind kind, size_t length, uint32_t address) {
  Peer& peer = _peers[index];
  if (kind == LiveRequest) {
    if (length != 0) return;
    uint16_t count = capturePixels(_plain + 2);
    InterCommsRadio::write16(_plain, count);
    sendPeer(index, LiveData, _plain, 2 + count * 3);
    return;
  }
  if (kind == LiveData) {
    if (length < 2) return;
    uint16_t count = InterCommsRadio::read16(_plain);
    if (count > LIVE_LED_LIMIT || length != 2 + size_t(count) * 3) return;
    Member& member = _members[index];
    memcpy(member.livePixels, _plain + 2, count * 3); member.liveCount = count; member.liveAt = millis();
    return;
  }
  if (kind == FirmwareData) {
    if (_firmware.active && !_firmware.local && index == _firmware.source && equal(_firmware.sourceBoot, peer.boot, sizeof(_firmware.sourceBoot)) && length > 4 && read32(_plain) == _firmware.offset) writeFirmware(_plain + 4, length - 4);
    return;
  }
  if (kind == FirmwareRequest) {
    if (!_members[index].updateTracked || !_staged || length != 36 || !equal(_plain + 4, _stagedHash, 32)) return;
    uint32_t offset = read32(_plain);
    if (offset >= _stagedSize) return;
    size_t count = std::min(size_t(FIRMWARE_CHUNK), size_t(_stagedSize - offset));
    write32(_plain, offset);
    if (readImage(offset, _plain + 4, count)) sendPeer(index, FirmwareData, _plain, count + 4);
    return;
  }
  DynamicJsonDocument document(8192);
  if (deserializeJson(document, _plain, length, DeserializationOption::NestingLimit(8)) || !document.is<JsonObject>()) return;
  JsonObject object = document.as<JsonObject>();
  if (kind == Heartbeat) {
    updateMemberFromHeartbeat(index, object, address);
  } else if (kind == State && index == _leader && settled() && _sync && !_firmware.active) {
    applyLighting(object);
  } else if (kind == Proposal && master() && _sync && !_firmware.active) {
    if (applyLighting(object)) _dirty = true;
  } else if (kind == Command && settled() && (index == _leader || !strcmp(object["op"] | "", "firmware"))) {
    uint32_t id = object["id"] | 0U;
    if (!id) return;
    Member& member = _members[index];
    // Retries repeat the cached ACK instead of applying settings or starting the same OTA offer twice.
    if (id != member.receivedCommand) {
      bool automatic = object["body"]["automatic"] | false;
      ReleaseVersion offered, current;
      bool allowed = !automatic || (offered.parse(object["body"]["version"] | "") && current.parse(versionString) && offered.compare(current) > 0);
      if (!allowed) strlcpy(_commandError, "Automatic update requires a newer stable release", sizeof(_commandError));
      member.receivedOk = allowed && command(object["op"], object["body"], index);
      member.receivedCommand = id;
      strlcpy(member.receivedResult, member.receivedOk ? "Applied" : _commandError[0] ? _commandError : "Rejected", sizeof(member.receivedResult));
    }
    document.clear(); document["id"] = id; document["ok"] = member.receivedOk; document["message"] = member.receivedResult;
    sendJson(index, Ack, document);
  } else if (kind == Ack && (master() || _members[index].updateTracked) && (object["id"] | 0U) == _members[index].commandId) {
    strlcpy(_members[index].result, object["message"] | "Rejected", sizeof(_members[index].result));
    _members[index].commandLength = 0;
    if (_members[index].updateTracked && !(object["ok"] | false)) _members[index].updatePhase = Failed;
  }
}

// Decode optional telemetry for old/new peers and confirm OTA completion only after the expected rebooted build appears.
void InterComms::updateMemberFromHeartbeat(int index, JsonObject object, uint32_t address) {
  Peer& peer = _peers[index];
  strlcpy(_members[index].name, object["name"] | "", sizeof(_members[index].name));
  strlcpy(_members[index].version, object["version"] | "", sizeof(_members[index].version));
  strlcpy(_members[index].firmwareVersion, object["releaseVersion"] | _members[index].version, sizeof(_members[index].firmwareVersion));
  peer.canLead = object["canLead"] | true;
  peer.gatewayScore = constrain(object["gatewayScore"] | 0, 0, 18);
  _members[index].wifiRssi = constrain(object["wifiRssi"] | -127, -127, 0);
  _members[index].liveRelay = object["liveRelay"] | false;
  if (address) _members[index].lanAddress = address;
  else {
    IPAddress lan;
    const char* ip = object["ip"] | "";
    _members[index].lanAddress = strnlen(ip, 16) < 16 && lan.fromString(ip) ? uint32_t(lan) : 0;
  }
  _members[index].peerUpdates = object["peerUpdates"] | false;
  _members[index].autoUpdates = object["autoUpdates"] | false;
  _members[index].simulated = object["simulated"] | (!_members[index].version[0] || strstr(_members[index].version, "(sim)") != nullptr);
  _members[index].sync = object["sync"] | true; _members[index].brightness = object["bri"] | 0; _members[index].effect = object["fx"] | 0;
  // New telemetry is optional for older peers and validated before narrowing.
  _members[index].lightingKnown = object["on"].is<bool>() && object["sx"].is<unsigned>() && object["sx"].as<unsigned>() <= 255 && object["ix"].is<unsigned>() && object["ix"].as<unsigned>() <= 255 && object["col"].is<uint32_t>();
  if (_members[index].lightingKnown) {
    _members[index].power = object["on"]; _members[index].speed = object["sx"]; _members[index].intensity = object["ix"]; _members[index].color = object["col"];
  }
  const char* buildId = object["buildId"] | "";
  uint8_t buildBytes[BUILD_ID_BYTES];
  if (fromHex(buildId, buildBytes, sizeof(buildBytes))) strlcpy(_members[index].buildId, buildId, sizeof(_members[index].buildId));
  Member& member = _members[index];
  member.updateTelemetry = object.containsKey("updatePhase");
  uint32_t offset = object["updateOffset"] | 0U;
  if (offset != member.updateOffset) member.updateProgressAt = millis();
  member.updateOffset = offset;
  uint32_t updateSize = object["updateSize"] | 0U;
  if (updateSize || !member.updateTracked) member.updateSize = updateSize;
  unsigned phase = object["updatePhase"] | unsigned(Idle);
  if (member.updateTracked && member.rebootDetected) {
    // A reboot is not completion until the new heartbeat identifies the exact offered build.
    member.updatePhase = member.expectedBuild[0] && !strcmp(member.expectedBuild, member.buildId) ? Complete : Failed;
    strlcpy(member.result, member.updatePhase == Complete ? "Firmware build verified after reboot" : "Device rebooted but the installed build does not match", sizeof(member.result));
    if (member.updatePhase == Complete) member.updateTracked = false;
  } else if (member.updatePhase != Complete && member.updatePhase != Failed && phase > Idle && phase <= Failed) member.updatePhase = phase == Complete ? Rebooting : UpdatePhase(phase);
  const char* progress = object["update"] | "";
  bool reportedFailure = phase == Failed || (!member.updateTelemetry && (strstr(progress, "failed") || strstr(progress, "mismatch") || strstr(progress, "Incompatible")));
  if (!member.commandLength && *progress && (member.updateTracked || phase != Idle) && !member.rebootDetected && member.updatePhase != Complete && (member.updatePhase != Failed || reportedFailure)) strlcpy(member.result, progress, sizeof(member.result));
  if (member.updateTracked && reportedFailure) {
    member.updatePhase = Failed; member.commandLength = 0;
    if (*progress) strlcpy(member.result, progress, sizeof(member.result));
  } else if (member.updateTracked && !member.updateTelemetry && member.updatePhase != Failed && member.updatePhase != Complete) {
    // Legacy peers have no numeric phase; retain their text-based progress fallback.
    if (strstr(progress, "Downloading firmware")) member.updatePhase = Downloading;
    else if (strstr(progress, "Verified; rebooting")) member.updatePhase = Rebooting;
  }
}

// Share transfer telemetry even while the normal device overview is hidden.
void InterComms::sendHeartbeat(int peer) {
  DynamicJsonDocument document(1024);
  document["name"] = serverDescription; document["version"] = versionString; document["simulated"] = false; document["sync"] = _sync;
  document["on"] = bri > 0; document["sx"] = strip.getMainSegment().speed; document["ix"] = strip.getMainSegment().intensity; document["col"] = strip.getMainSegment().colors[0];
  document["bri"] = bri; document["fx"] = strip.getMainSegment().mode; document["update"] = _updateStatus;
  document["canLead"] = true; document["gatewayScore"] = _gatewayScore;
  document["wifiRssi"] = WiFi.status() == WL_CONNECTED ? WiFi.RSSI() : -127;
  document["ip"] = WiFi.status() == WL_CONNECTED ? WiFi.localIP().toString() : String(); document["liveRelay"] = true;
  document["peerUpdates"] = true; document["autoUpdates"] = true; document["releaseVersion"] = versionString;
  document["buildId"] = _buildId; document["updatePhase"] = unsigned(_updatePhase);
  document["updateOffset"] = _firmware.offset; document["updateSize"] = _firmware.size;
  sendJson(peer, Heartbeat, document);
}

// Separate discovery from authenticated liveness; only verified peers participate in elections.
void InterComms::heartbeat() {
  _gatewayScore = gatewayScore();
  IPAddress broadcast = WiFi.localIP();
  IPAddress mask = WiFi.subnetMask();
  for (size_t i = 0; i < 4; i++) broadcast[i] |= uint8_t(~mask[i]);
  const uint8_t canLead = 1;
  if (_socketReady) sendPacket(Hello, &canLead, sizeof(canLead), broadcast, nullptr);
  if (_radio.ready()) sendPacket(Hello, &canLead, sizeof(canLead), IPAddress(), nullptr, true);
  for (size_t i = 0; i < MAX_PEERS; i++) if (_peers[i].live(millis())) sendHeartbeat(i);
}

} // namespace InterCommsInternal
// AI: end
