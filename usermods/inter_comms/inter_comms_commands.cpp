#include "wled.h"
#include "inter_comms_internal.h"
#include "crypto.h"

// AI: below section was generated by an AI
namespace InterCommsInternal {
using namespace InterCommsCrypto;

// These phase strings are part of the dashboard's JSON interface.
static const char* phaseName(UpdatePhase phase) {
  switch (phase) {
    case Preparing: return "preparing";
    case QueuedUpdate: return "queued";
    case Downloading: return "downloading";
    case Verifying: return "verifying";
    case Rebooting: return "rebooting";
    case Complete: return "complete";
    case Failed: return "error";
    default: return "idle";
  }
}

// Sample actual output, bounded independently of the configured strip size.
uint16_t InterComms::capturePixels(uint8_t* pixels) {
  size_t total = strip.getLengthTotal();
  uint16_t count = std::min(total, LIVE_LED_LIMIT);
  for (size_t i = 0; i < count; i++) {
    uint32_t color = strip.getPixelColor(i * total / count);
    pixels[i * 3] = qadd8(W(color), R(color));
    pixels[i * 3 + 1] = qadd8(W(color), G(color));
    pixels[i * 3 + 2] = qadd8(W(color), B(color));
  }
  return count;
}

// Return cached remote pixels through the gateway; only authenticated requests refresh them.
void InterComms::live(JsonObject request, JsonObject result) {
  uint8_t target[6];
  if (!fromHex(request["target"], target, sizeof(target))) { result["error"] = "Invalid live device"; return; }
  JsonArray leds = result.createNestedArray("leds");
  uint8_t pixels[LIVE_LED_LIMIT * 3];
  uint16_t count = 0;
  if (equal(target, _id, sizeof(target))) count = capturePixels(pixels);
  else {
    int index = peerFor(target, false);
    if (index < 0 || !_peers[index].live(millis())) { result["error"] = "Live device is offline"; return; }
    Member& member = _members[index];
    if (!member.liveRelay) { result["error"] = "Update this device to relay its live output"; return; }
    if (elapsed(millis(), member.liveRequested, 150)) {
      if (sendPeer(index, LiveRequest, nullptr, 0)) member.liveRequested = millis();
    }
    if (!elapsed(millis(), member.liveAt, 1000)) {
      count = member.liveCount; memcpy(pixels, member.livePixels, count * 3);
    }
  }
  for (size_t i = 0; i < count; i++) {
    char color[7]; snprintf(color, sizeof(color), "%02x%02x%02x", pixels[i * 3], pixels[i * 3 + 1], pixels[i * 3 + 2]);
    leds.add(String(color));
  }
  result["ok"] = true;
}

// Publish only lighting state; presets, playlists, hardware and network settings are not executable state messages.
void InterComms::lighting(JsonObject object) {
  serializeState(object, true, true, true, false);
  object["tb"] = uint32_t(millis() + strip.timebase);
}

// Copy a strict state allowlist before invoking WLED's existing range-clamped JSON parser.
bool InterComms::applyLighting(JsonObject input) {
  if (input.isNull()) return false;
  DynamicJsonDocument safe(8192);
  JsonObject output = safe.to<JsonObject>();
  for (const char* key : {"on", "bri", "transition", "mainseg"}) if (input.containsKey(key)) output[key] = input[key];
  if (input.containsKey("seg")) {
    JsonArray segments = input["seg"];
    if (segments.isNull() || segments.size() > WS2812FX::getMaxSegments()) return false;
    JsonArray result = output.createNestedArray("seg");
    for (JsonObject segment : segments) {
      if (segment.isNull()) return false;
      JsonObject target = result.createNestedObject();
      for (const char* key : {"id", "start", "stop", "grp", "spc", "of", "on", "bri", "col", "fx", "sx", "ix", "pal", "sel", "rev", "mi", "c1", "c2", "c3", "o1", "o2", "o3", "si", "m12", "set"}) {
        if (segment.containsKey(key)) target[key] = segment[key];
      }
      if (target.containsKey("start")) target["start"] = constrain(target["start"].as<int>(), 0, int(strip.getLengthTotal()));
      if (target.containsKey("stop")) target["stop"] = constrain(target["stop"].as<int>(), 0, int(strip.getLengthTotal()));
    }
  }
  if (safe.overflowed()) return false;
  if (input["tb"].is<uint32_t>()) strip.timebase = input["tb"].as<uint32_t>() - millis();
  _applying = true;
  deserializeState(output, CALL_MODE_NO_NOTIFY);
  _applying = false;
  return true;
}

// Persist only explicit project settings, never arbitrary cfg.json objects or GPIO fields.
bool InterComms::applySettings(JsonObject settings) {
  if (settings.isNull()) return false;
  for (JsonPair entry : settings) {
    const char* key = entry.key().c_str();
    if (strcmp(key, "name") && strcmp(key, "sync") && strcmp(key, "bootOn") && strcmp(key, "bootBrightness") && strcmp(key, "transitionMs")) return false;
  }
  if (settings.containsKey("name") && (!settings["name"].is<const char*>() || strnlen(settings["name"], sizeof(serverDescription)) >= sizeof(serverDescription))) return false;
  if (settings.containsKey("sync") && !settings["sync"].is<bool>()) return false;
  if (settings.containsKey("bootOn") && !settings["bootOn"].is<bool>()) return false;
  if (settings.containsKey("bootBrightness") && (!settings["bootBrightness"].is<unsigned>() || settings["bootBrightness"].as<unsigned>() > 255)) return false;
  if (settings.containsKey("transitionMs") && (!settings["transitionMs"].is<unsigned>() || settings["transitionMs"].as<unsigned>() > 60000)) return false;
  if (settings.containsKey("name")) strlcpy(serverDescription, settings["name"], sizeof(serverDescription));
  if (settings.containsKey("sync") && _sync != settings["sync"].as<bool>()) {
    _sync = settings["sync"];
    // Rejoining followers adopt the master's next snapshot instead of publishing stale local edits.
    _changed.store(false);
    _dirty = _sync && master();
  }
  if (settings.containsKey("bootOn")) turnOnAtBoot = settings["bootOn"];
  if (settings.containsKey("bootBrightness")) briS = settings["bootBrightness"];
  if (settings.containsKey("transitionMs")) transitionDelayDefault = settings["transitionMs"];
  configNeedsWrite = true;
  return true;
}

// Dispatch the same bounded command allowlist for local administration and peer commands.
bool InterComms::command(const char* op, JsonObject body, int source) {
  _commandError[0] = 0;
  if (!op) return false;
  if (!strcmp(op, "lighting")) {
    if (body.containsKey("independent") && !body["independent"].is<bool>()) return false;
    if (_firmware.active || !applyLighting(body)) return false;
    // Explicit dashboard edits opt the target out of periodic group snapshots.
    if ((body["independent"] | false) && _sync) {
      _sync = false; _dirty = false; _changed.store(false); configNeedsWrite = true;
    }
    return true;
  }
  if (!strcmp(op, "settings")) return applySettings(body);
  if (!strcmp(op, "firmware")) return beginFirmware(body, source);
  return false;
}

// Track one reliable command per peer; responses expose acknowledgement or timeout to the dashboard.
bool InterComms::queueCommand(int peer, const char* op, JsonObject body) {
  Member& member = _members[peer];
  if (member.commandLength || !++_commandId) return false;
  DynamicJsonDocument document(2048);
  document["op"] = op; document["id"] = _commandId; document["body"] = body;
  size_t length = measureJson(document);
  if (document.overflowed() || length >= sizeof(member.command)) return false;
  member.commandLength = serializeJson(document, member.command, sizeof(member.command));
  member.commandId = _commandId; member.attempts = 0; member.commandSent = millis() - COMMAND_RETRY_MS;
  strlcpy(member.result, "Queued", sizeof(member.result));
  return true;
}

// Retry each queued peer command within its existing attempt/time limits, preserving update failure reporting.
void InterComms::serviceCommands(uint32_t now) {
  for (size_t i = 0; i < MAX_PEERS; i++) {
    Member& member = _members[i];
    if (!master() && !member.updateTracked) continue;
    if (!member.commandLength || !elapsed(now, member.commandSent, COMMAND_RETRY_MS)) continue;
    if (!_peers[i].live(now) || member.attempts >= COMMAND_ATTEMPTS) {
      member.commandLength = 0; strlcpy(member.result, "No acknowledgement", sizeof(member.result)); if (member.updateTracked) member.updatePhase = Failed; continue;
    }
    sendPeer(i, Command, reinterpret_cast<const uint8_t*>(member.command), member.commandLength);
    member.commandSent = now; member.attempts++;
  }
}

// Report current device and upload progress to the public dashboard.
void InterComms::status(JsonObject result) {
  result["ok"] = true; result["master"] = master(); result["settled"] = settled();
  result["electionPending"] = _leaderCandidate != -2;
  result["profileId"] = toHex(INTER_COMMS_IMAGE_ID, sizeof(INTER_COMMS_IMAGE_ID));
  result["localId"] = toHex(_id, 6);
  result["masterId"] = toHex(_leader < 0 ? _id : _peers[_leader].id, 6);
  result["masterIp"] = _leader < 0 ? (WiFi.status() == WL_CONNECTED ? WiFi.localIP() : WiFi.softAPIP()).toString() :
    IPAddress(_peers[_leader].address ? _peers[_leader].address : _members[_leader].lanAddress).toString();
  result["invalidPackets"] = _invalidPackets;
  result["radioReady"] = _radio.ready(); result["radioDropped"] = _radio.dropped(); result["radioChannel"] = WiFi.channel();
  result["autoUpdates"] = true; result["autoUpdateStatus"] = _autoStatus;
  result["firmwareStatus"] = _updateStatus; result["staged"] = _staged;
  result["canShareCurrent"] = true;
  result["preparingCurrent"] = _preparingCurrent; result["prepareOffset"] = _prepareOffset; result["prepareSize"] = _prepareSize;
  result["stagedBuild"] = _stagedBuild; result["imageSource"] = _sourceRunning ? "running" : "upload";
  result["uploadActive"] = bool(_upload); result["uploadOffset"] = _uploadOffset; result["uploadSize"] = _uploadSize;
  result["firmwareOffset"] = _firmware.offset; result["firmwareSize"] = _firmware.size;
  JsonArray devices = result.createNestedArray("devices");
  JsonObject local = devices.createNestedObject();
  local["id"] = toHex(_id, 6); local["name"] = serverDescription; local["version"] = versionString;
  local["ip"] = (WiFi.status() == WL_CONNECTED ? WiFi.localIP() : WiFi.softAPIP()).toString();
  local["wifiRssi"] = WiFi.status() == WL_CONNECTED ? WiFi.RSSI() : -127;
  local["gatewayScore"] = _gatewayScore; local["liveRelay"] = true; local["transport"] = "local";
  local["buildId"] = _buildId; local["updateState"] = phaseName(_updatePhase);
  local["updateOffset"] = _preparingCurrent ? _prepareOffset : _firmware.offset; local["updateSize"] = _preparingCurrent ? _prepareSize : _firmware.size; local["updateTelemetry"] = true;
  const auto& segment = strip.getMainSegment();
  local["on"] = bri > 0; local["sx"] = segment.speed; local["ix"] = segment.intensity; local["col"] = segment.colors[0];
  local["lightingKnown"] = true;
  local["online"] = true; local["simulated"] = false; local["sync"] = _sync; local["bri"] = bri; local["fx"] = strip.getMainSegment().mode; local["result"] = _updateStatus;
  for (size_t i = 0; i < MAX_PEERS; i++) {
    bool online = _peers[i].live(millis());
    if (!online && !_members[i].updateTracked && _members[i].updatePhase != Complete) continue;
    JsonObject device = devices.createNestedObject();
    device["online"] = online;
    device["id"] = toHex(_peers[i].id, 6); device["name"] = _members[i].name; device["version"] = _members[i].version;
    device["buildId"] = _members[i].buildId; device["updateState"] = phaseName(_members[i].updatePhase);
    device["updateOffset"] = _members[i].updateOffset; device["updateSize"] = _members[i].updateSize;
    device["updateTelemetry"] = _members[i].updateTelemetry;
    device["simulated"] = _members[i].simulated;
    uint32_t lanAddress = _peers[i].address ? _peers[i].address : _members[i].lanAddress;
    device["ip"] = lanAddress ? IPAddress(lanAddress).toString() : String(); device["sync"] = _members[i].sync;
    device["transport"] = _peers[i].address ? "udp" : "espnow";
    device["wifiRssi"] = _members[i].wifiRssi; device["radioRssi"] = _members[i].radioRssi;
    device["gatewayScore"] = _peers[i].gatewayScore; device["liveRelay"] = _members[i].liveRelay;
    device["lightingKnown"] = _members[i].lightingKnown;
    if (_members[i].lightingKnown) {
      device["on"] = _members[i].power; device["sx"] = _members[i].speed; device["ix"] = _members[i].intensity; device["col"] = _members[i].color;
    }
    device["bri"] = _members[i].brightness; device["fx"] = _members[i].effect; device["result"] = _members[i].result;
  }
}

// Dashboard commands are public; device-to-device commands still require group authentication.
void InterComms::admin(JsonObject input, JsonObject result) {
  const char* op = input["op"] | "";
  if (!strcmp(op, "status")) { status(result); return; }
  if (!strcmp(op, "live")) { live(input, result); return; }
  if (!strcmp(op, "effects")) {
    result["ok"] = true;
    JsonArray effects = result.createNestedArray("effects");
    for (size_t i = 0; i < strip.getModeCount(); i++) {
      const char* name = strip.getModeData(i);
      char label[48]; size_t j = 0;
      while (j + 1 < sizeof(label) && name[j] && name[j] != '@') { label[j] = name[j]; j++; }
      label[j] = 0; effects.add(label);
    }
    return;
  }
  JsonObject body = input["body"];
  if (!strcmp(op, "wifi")) {
    const char* ssid = body["ssid"], *password = body["password"];
    if (!ssid || !password || !strnlen(ssid, 33) || strnlen(ssid, 33) > 32 || strnlen(password, 65) > 64 || !input["confirm"].as<bool>()) { result["error"] = "Invalid Wi-Fi setup"; return; }
    multiWiFi.clear(); multiWiFi.emplace_back(ssid, password);
    configNeedsWrite = true;
    result["ok"] = true; result["message"] = "Wi-Fi saved; reboot to connect";
    return;
  }
  if (!strcmp(op, "reboot")) { result["ok"] = true; doReboot = true; return; }
  if (!master()) { result["error"] = "Open the elected master dashboard; election takes five seconds"; return; }
  if (!strcmp(op, "prepareCurrent")) {
    result["ok"] = prepareCurrent(); if (_commandError[0]) result["error"] = _commandError; return;
  }
  if (!strncmp(op, "upload", 6)) {
    result["ok"] = stage(op, body);
    if (_uploadError[0]) result["error"] = _uploadError;
    return;
  }
  if (!strcmp(op, "rollout") || !strcmp(op, "installLocal")) {
    distributeFirmware(op, input["target"] | "all", result);
    return;
  }
  if (strcmp(op, "settings") && strcmp(op, "lighting")) { result["error"] = "Unknown command"; return; }
  dispatchToTargets(op, body, input["target"] | "all", result);
}

// Apply locally and queue remote recipients; accepted commands can still be awaiting a peer's ACK.
void InterComms::dispatchToTargets(const char* op, JsonObject body, const char* target, JsonObject result) {
  bool all = !strcmp(target, "all");
  uint8_t identifier[6];
  if (!all && !fromHex(target, identifier, 6)) { result["error"] = "Invalid device ID"; return; }
  unsigned accepted = 0, failed = 0;
  if (all || equal(identifier, _id, 6)) { if (command(op, body, -1)) accepted++; else failed++; }
  for (size_t i = 0; i < MAX_PEERS; i++) {
    if (_peers[i].live(millis()) && (all || equal(identifier, _peers[i].id, 6))) {
      if (queueCommand(i, op, body)) accepted++; else failed++;
    }
  }
  if (all && !strcmp(op, "lighting")) _dirty = true;
  result["ok"] = accepted > 0 && failed == 0; result["accepted"] = accepted; result["failed"] = failed;
}

// Recover after dropped packets with periodic snapshots; effect clocks share the leader's timebase.
void InterComms::synchronize() {
  if (!settled() || !_sync || _firmware.active) return;
  if (_changed.exchange(false)) { _dirty = true; _lastLocal = millis(); }
  bool periodic = master() && elapsed(millis(), _lastState, HEARTBEAT_MS);
  if (!periodic && (!_dirty || !elapsed(millis(), _lastLocal, 60))) return;
  DynamicJsonDocument document(8192);
  lighting(document.to<JsonObject>());
  if (document.overflowed() || measureJson(document) > MAX_PAYLOAD) { _dirty = false; return; }
  if (master()) {
    // Resume at the first unsent peer if a large snapshot exhausts the bounded transport queue.
    for (size_t step = 0; step < MAX_PEERS; step++) {
      size_t i = (_stateCursor + step) % MAX_PEERS;
      if (_peers[i].live(millis()) && _members[i].sync && !sendJson(i, State, document)) { _stateCursor = i; break; }
    }
  } else sendJson(_leader, Proposal, document);
  _dirty = false; _lastState = millis();
}

} // namespace InterCommsInternal
// AI: end
