#pragma once
#include "radio_protocol.h"
#include <atomic>
#include <esp_now.h>
#include <esp_wifi.h>
#include <freertos/queue.h>

// AI: below section was generated by an AI
// ESP-NOW transports the existing AES-GCM envelopes, including receiver challenges and replay checks.
class InterCommsRadioTransport {
  static constexpr size_t TX_CAPACITY = 16384;
  static constexpr size_t RX_SLOTS = 16;
  struct Received {
    uint8_t sender[6];
    int8_t rssi;
    uint8_t channel;
    uint16_t length;
    uint8_t data[InterCommsRadio::MTU];
  };
  QueueHandle_t _received = nullptr;
  struct RadioPeer {
    uint8_t address[6] = {};
    uint32_t usedAt = 0;
    bool used = false;
  } _peers[InterCommsProtocol::MAX_PEERS];
  InterCommsRadio::Reassembler _assembly;
  uint8_t _tx[TX_CAPACITY] = {}, _fragment[InterCommsRadio::MTU] = {};
  size_t _head = 0, _tail = 0, _used = 0, _offset = 0;
  uint32_t _checked = 0, _sentAt = 0;
  bool _ready = false, _initialized = false, _awaiting = false;
  size_t _lastFragment = 0;
  uint8_t _fragmentAttempts = 0;
  std::atomic<bool> _sending{false};
  std::atomic<int8_t> _sendResult{0};
  std::atomic<unsigned> _dropped{0};
  static InterCommsRadioTransport* _instance;
  static const uint8_t BROADCAST[6];

  // The Wi-Fi task only copies validated-size input into a bounded FreeRTOS queue.
  static void receiveCallback(const esp_now_recv_info_t* info, const uint8_t* data, int length) {
    if (!_instance || !info || !info->src_addr || !data || length <= int(InterCommsRadio::FRAGMENT_HEADER) ||
        length > int(InterCommsRadio::MTU) || memcmp(data, "ICR1", 4)) return;
    Received packet;
    memcpy(packet.sender, info->src_addr, 6);
    packet.length = length; packet.rssi = info->rx_ctrl ? info->rx_ctrl->rssi : 0;
    packet.channel = info->rx_ctrl ? info->rx_ctrl->channel : 0;
    memcpy(packet.data, data, length);
    if (xQueueSend(_instance->_received, &packet, 0) != pdTRUE) _instance->_dropped++;
  }

  // One in-flight fragment avoids Wi-Fi task work and preserves fragment send order.
#if ESP_IDF_VERSION >= ESP_IDF_VERSION_VAL(5, 5, 0)
  static void sentCallback(const wifi_tx_info_t*, esp_now_send_status_t status) {
#else
  static void sentCallback(const uint8_t*, esp_now_send_status_t status) {
#endif
    if (_instance) {
      _instance->_sendResult.store(status == ESP_NOW_SEND_SUCCESS ? 1 : -1);
      _instance->_sending.store(false);
    }
  }

  uint8_t at(size_t offset) const { return _tx[(_head + offset) % TX_CAPACITY]; }
  void append(uint8_t value) { _tx[_tail] = value; _tail = (_tail + 1) % TX_CAPACITY; _used++; }

  // Wi-Fi reconnects may recreate the driver; re-establish only this module's broadcast peer.
  void initialize() {
    if (!_received || !(WiFi.getMode() & WIFI_STA)) return;
    if (esp_now_init() != ESP_OK) return;
    _initialized = true;
    if (esp_now_register_recv_cb(receiveCallback) != ESP_OK || esp_now_register_send_cb(sentCallback) != ESP_OK) return;
    if (!esp_now_is_peer_exist(BROADCAST)) {
      esp_now_peer_info_t peer = {};
      memcpy(peer.peer_addr, BROADCAST, 6); peer.ifidx = WIFI_IF_STA; peer.channel = 0;
      if (esp_now_add_peer(&peer) != ESP_OK) return;
    }
    _sending.store(false); _ready = true;
  }

  // Keep at most sixteen unicast peers plus discovery broadcast; recycled memberships cannot fill the SDK table.
  bool ensurePeer(const uint8_t* address) {
    if (!memcmp(address, BROADCAST, 6)) return esp_now_is_peer_exist(BROADCAST);
    RadioPeer* slot = nullptr;
    RadioPeer* oldest = &_peers[0];
    uint32_t now = millis();
    for (auto& peer : _peers) {
      if (peer.used && !memcmp(peer.address, address, 6)) { slot = &peer; break; }
      if (!peer.used) slot = &peer;
      if (uint32_t(now - peer.usedAt) > uint32_t(now - oldest->usedAt)) oldest = &peer;
    }
    if (!slot) slot = oldest;
    if (slot->used && memcmp(slot->address, address, 6)) esp_now_del_peer(slot->address);
    if (!esp_now_is_peer_exist(address)) {
      esp_now_peer_info_t peer = {};
      memcpy(peer.peer_addr, address, 6); peer.ifidx = WIFI_IF_STA; peer.channel = 0;
      if (esp_now_add_peer(&peer) != ESP_OK) return false;
    }
    memcpy(slot->address, address, 6); slot->used = true; slot->usedAt = now;
    return true;
  }

public:
  // Allocate callback storage once; a failed allocation leaves direct communication disabled.
  void begin() {
    static_assert(InterCommsRadio::MTU <= ESP_NOW_MAX_DATA_LEN, "Radio fragments must fit ESP-NOW v1");
    static_assert((InterCommsProtocol::MAX_FRAME + InterCommsRadio::FRAGMENT_DATA - 1) / InterCommsRadio::FRAGMENT_DATA <= 16, "Reassembly bitmap is too small");
    _received = xQueueCreate(RX_SLOTS, sizeof(Received));
    // The module and queue live until reboot, so callbacks never observe a released instance.
    _instance = this;
  }
  bool ready() const { return _ready; }
  unsigned dropped() const { return _dropped.load(); }

  // Wi-Fi driver teardown must follow ESP-NOW deinitialization; discard stale queued envelopes on reset.
  void stop() {
    if (_initialized) {
      esp_now_unregister_recv_cb(); esp_now_unregister_send_cb(); esp_now_deinit();
    }
    _initialized = _ready = _awaiting = false;
    _sending.store(false); _sendResult.store(0);
    _head = _tail = _used = _offset = 0; _fragmentAttempts = 0;
    for (auto& peer : _peers) peer.used = false;
    if (_received) xQueueReset(_received);
  }

  // A byte ring fits many small heartbeats without reserving a maximum-size buffer per peer.
  bool send(const uint8_t* data, size_t length, const uint8_t* recipient = nullptr) {
    if (!_ready || length < InterCommsProtocol::HEADER_SIZE + InterCommsProtocol::TAG_SIZE ||
        length > InterCommsProtocol::MAX_FRAME || length + 8 > TX_CAPACITY - _used) return false;
    append(length >> 8); append(length);
    const uint8_t* address = recipient ? recipient : BROADCAST;
    for (size_t i = 0; i < 6; i++) append(address[i]);
    for (size_t i = 0; i < length; i++) append(data[i]);
    return true;
  }

  // Run on WLED's main loop; retries of commands remain the authenticated protocol's responsibility.
  void service() {
    uint32_t now = millis();
    if (InterCommsProtocol::elapsed(now, _checked, 500)) {
      _checked = now;
      if (_ready && !esp_now_is_peer_exist(BROADCAST)) _ready = false;
      if (!_ready) initialize();
    }
    if (!_ready || !_used) return;
    if (_sending.load()) {
      if (!InterCommsProtocol::elapsed(now, _sentAt, 500)) return;
      _dropped++; stop(); return;
    }
    size_t length = (size_t(at(0)) << 8) | at(1);
    if (_awaiting) {
      _awaiting = false;
      if (_sendResult.exchange(0) > 0) { _offset += _lastFragment; _fragmentAttempts = 0; }
      else if (++_fragmentAttempts >= 3) { _offset = length; _fragmentAttempts = 0; _dropped++; }
    }
    if (_offset == length) {
      _head = (_head + length + 8) % TX_CAPACITY;
      _used -= length + 8; _offset = 0;
      return;
    }
    uint8_t address[6];
    for (size_t i = 0; i < 6; i++) address[i] = at(2 + i);
    if (!ensurePeer(address)) { _offset = length; _dropped++; return; }
    size_t count = std::min(InterCommsRadio::FRAGMENT_DATA, length - _offset);
    memcpy(_fragment, "ICR1", 4);
    InterCommsRadio::write16(_fragment + 4, length); InterCommsRadio::write16(_fragment + 6, _offset);
    for (size_t i = 0; i < 4; i++) _fragment[8 + i] = at(8 + 44 + i);
    for (size_t i = 0; i < count; i++) _fragment[InterCommsRadio::FRAGMENT_HEADER + i] = at(8 + _offset + i);
    _lastFragment = count; _awaiting = true; _sendResult.store(0);
    _sending.store(true); _sentAt = now;
    esp_err_t error = esp_now_send(address, _fragment, count + InterCommsRadio::FRAGMENT_HEADER);
    if (error != ESP_OK) {
      _sending.store(false); _awaiting = false; _fragmentAttempts = 0;
      // Drop this envelope instead of letting an unavailable driver strand the queue.
      _offset = length; _dropped++;
      if (error == ESP_ERR_ESPNOW_NOT_INIT || error == ESP_ERR_ESPNOW_IF || error == ESP_ERR_ESPNOW_NOT_FOUND) _ready = false;
    }
  }

  // Reassemble at most one queued fragment per call; authentication follows in the backend.
  bool receive(uint8_t* output, size_t& length, int8_t& rssi, uint8_t& channel) {
    if (!_received) return false;
    Received packet;
    if (xQueueReceive(_received, &packet, 0) != pdTRUE) return false;
    rssi = packet.rssi;
    channel = packet.channel;
    return _assembly.accept(packet.sender, packet.data, packet.length, millis(), output, length);
  }
};
// AI: end
