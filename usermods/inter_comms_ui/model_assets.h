#pragma once
#include "wled.h"
#include "../inter_comms/crypto.h"
#include "dashboard_generated.h"
#include <mbedtls/sha256.h>

// AI: below section was generated by an AI
// Only manifest-listed images can be installed; configuration paths are never accepted.
class InterCommsModelAssets {
private:
  static constexpr size_t CHUNK_SIZE = 768;
  static constexpr uint32_t TIMEOUT_MS = 60000;
  static constexpr const char* TEMP_PATH = "/inter_comms/model-upload.tmp";
  File _upload;
  const InterCommsModelAsset* _model = nullptr;
  size_t _received = 0;
  uint32_t _lastActivity = 0;
  mbedtls_sha256_context _sha;

  // Existence and size checks avoid loading an image into RAM.
  static bool installed(const InterCommsModelAsset& model) {
    File file = WLED_FS.open(model.path, "r");
    return file && file.size() == model.size;
  }

  // Discard only the temporary model file, leaving installed images and settings intact.
  void abortUpload() {
    if (_upload) _upload.close();
    if (_model) WLED_FS.remove(TEMP_PATH);
    _model = nullptr;
    _received = 0;
    mbedtls_sha256_free(&_sha);
    mbedtls_sha256_init(&_sha);
  }

  // Return a handled RPC error and optionally release this upload's resources.
  bool fail(JsonObject reply, const char* message, bool discard = false) {
    if (discard) abortUpload();
    reply["error"] = message;
    return true;
  }

public:
  InterCommsModelAssets() { mbedtls_sha256_init(&_sha); }

  // Expire interrupted uploads from the main loop so a disconnected installer cannot hold the slot.
  void loop() {
    if (_model && uint32_t(millis() - _lastActivity) >= TIMEOUT_MS) abortUpload();
  }

  // Stream allowlisted files directly from LittleFS with immutable cache headers.
  bool serve(AsyncWebServerRequest* request) {
    if (request->method() != HTTP_GET) return false;
    for (const auto& model : INTER_COMMS_MODELS) {
      if (request->url() != model.path) continue;
      File file = WLED_FS.open(model.path, "r");
      if (!file || file.size() != model.size) {
        request->send(404, "text/plain", "Model image is not installed");
        return true;
      }
      AsyncWebServerResponse* response = request->beginResponse(file, model.path, "image/webp");
      if (!response) {
        request->send(503);
        return true;
      }
      response->addHeader(F("Cache-Control"), F("public, max-age=31536000, immutable"));
      response->addHeader(F("X-Content-Type-Options"), F("nosniff"));
      request->send(response);
      return true;
    }
    return false;
  }

  // Handle model installation through the existing bounded RPC queue on WLED's main loop.
  bool execute(JsonObject command, JsonObject reply) {
    using namespace InterCommsCrypto;
    const char* op = command["op"] | "";
    if (!strcmp(op, "modelStatus")) {
      JsonArray assets = reply.createNestedArray("models");
      for (const auto& model : INTER_COMMS_MODELS) {
        JsonObject asset = assets.createNestedObject();
        asset["path"] = model.path;
        asset["sha256"] = model.sha256;
        asset["size"] = model.size;
        asset["installed"] = installed(model);
      }
      reply["ok"] = true;
      return true;
    }
    if (strcmp(op, "modelBegin") && strcmp(op, "modelChunk") && strcmp(op, "modelFinish") && strcmp(op, "modelAbort")) return false;
    JsonObject body = command["body"].as<JsonObject>();
    const char* path = body["path"] | "";
    const InterCommsModelAsset* model = nullptr;
    for (const auto& candidate : INTER_COMMS_MODELS) {
      if (!strcmp(path, candidate.path)) {
        model = &candidate;
        break;
      }
    }
    if (!model) return fail(reply, "Unknown model image; install matching firmware first");
    if (!strcmp(op, "modelBegin")) {
      if (_model) return fail(reply, "Another model upload is in progress");
      // Reclaim an interrupted pre-reboot transfer before checking available capacity.
      if (WLED_FS.exists(TEMP_PATH) && !WLED_FS.remove(TEMP_PATH)) return fail(reply, "Cannot discard interrupted model upload");
      if (installed(*model)) {
        reply["ok"] = true;
        reply["installed"] = true;
        return true;
      }
      const size_t total = WLED_FS.totalBytes(), used = WLED_FS.usedBytes();
      if (used > total || model->size > total - used || total - used - model->size < 65536)
        return fail(reply, "Not enough filesystem space for this model");
      if (!WLED_FS.exists("/inter_comms") && !WLED_FS.mkdir("/inter_comms")) return fail(reply, "Cannot create model directory");
      _model = model;
      _upload = WLED_FS.open(TEMP_PATH, "w");
      if (!_upload || mbedtls_sha256_starts(&_sha, 0)) return fail(reply, "Cannot start model upload", true);
      _received = 0;
      _lastActivity = millis();
    } else {
      if (_model != model || !_upload) return fail(reply, "No upload for this model");
      if (!strcmp(op, "modelAbort")) {
        abortUpload();
      } else if (!strcmp(op, "modelChunk")) {
        const char* data = body["data"] | "";
        const size_t chars = strnlen(data, CHUNK_SIZE * 2 + 1);
        uint8_t bytes[CHUNK_SIZE];
        if (!body["offset"].is<uint32_t>() || body["offset"].as<uint32_t>() != _received || !chars || chars > CHUNK_SIZE * 2 || chars % 2 ||
            chars / 2 > model->size - _received || !fromHex(data, bytes, chars / 2))
          return fail(reply, "Invalid model chunk", true);
        if (_upload.write(bytes, chars / 2) != chars / 2 || mbedtls_sha256_update(&_sha, bytes, chars / 2))
          return fail(reply, "Cannot write model chunk", true);
        _received += chars / 2;
        _lastActivity = millis();
      } else {
        uint8_t digest[32], expected[32];
        if (_received != model->size || !fromHex(model->sha256, expected, sizeof(expected)) || mbedtls_sha256_finish(&_sha, digest) ||
            !equal(digest, expected, sizeof(digest)))
          return fail(reply, "Model size or SHA-256 mismatch", true);
        _upload.close();
        if (!WLED_FS.rename(TEMP_PATH, model->path)) return fail(reply, "Cannot install model image", true);
        abortUpload();
      }
    }
    reply["ok"] = true;
    return true;
  }
};
// AI: end
